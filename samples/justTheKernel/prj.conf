## CMakeLists.txt
```
# SPDX-License-Identifier: Apache-2.0

cmake_minimum_required(VERSION 3.13.1)
find_package(Zephyr REQUIRED HINTS $ENV{ZEPHYR_BASE})

project(helloWorldLed)

FILE(GLOB app_sources src/*.c)
target_sources(app PRIVATE ${app_sources})
```

## prj.conf
```kconfig
# disable all peripherals
CONFIG_GPIO=n
CONFIG_SERIAL=n
CONFIG_SPI=n
CONFIG_I2C=n

# disable the boot banner
CONFIG_BOOT_BANNER=n

#disable all debug and log messages
CONFIG_DEBUG=n
```

## ultraminimal.conf
```kconfig
# disable all peripherals and drivers
CONFIG_WATCHDOG=n
CONFIG_PINMUX=n
CONFIG_GPIO=n
CONFIG_SERIAL=n
CONFIG_SPI=n
CONFIG_I2C=n
CONFIG_FLASH=n
CONFIG_EEPROM=n


# disable power management
CONFIG_PM=n

# disable the boot banner and delay
CONFIG_BOOT_DELAY=0
CONFIG_BOOT_BANNER=n

# disable dynamic interrupts
CONFIG_DYNAMIC_INTERRUPTS=n
CONFIG_IRQ_OFFLOAD=n

# disable memory protection
CONFIG_THREAD_STACK_INFO=n
CONFIG_THREAD_CUSTOM_DATA=n
CONFIG_FPU=n

# disable all console, debug and log messages
CONFIG_DEBUG=n
CONFIG_CONSOLE=n
CONFIG_UART_CONSOLE=n
CONFIG_STDOUT_CONSOLE=n
CONFIG_PRINTK=n
CONFIG_EARLY_CONSOLE=n

# single-threaded, no timer support in the kernel
CONFIG_MULTITHREADING=n
CONFIG_KERNEL_MEM_POOL=n

# disable timer support in the kernel
CONFIG_SYS_CLOCK_EXISTS=n

# enable compiler size opt. (this is the default anyway)
CONFIG_SIZE_OPTIMIZATIONS=y
```

## src/main.c
```c
/*
 * Copyright (c) 2020 Thomas Popp
 *
 * SPDX-License-Identifier: Apache-2.0
 */

#include <zephyr.h>


// -----------------------------------------------------------------------------
void main (void) {
    uint32_t i = 0;
    
    // run the loop for ever
    while (true) {
        i++;
    }
}
```
